## CMakeLists.txt
```
set(ENV{ZEPHYR_BASE} /home/geymerson/zephyr)
set(ENV{ZEPHYR_TOOLCHAIN_VARIANT} zephyr)
set(ENV{ZEPHYR_SDK_INSTALL_DIR} /home/geymerson/zephyr-sdk)

set(BOARD "bbc_microbit")

include($ENV{ZEPHYR_BASE}/cmake/app/boilerplate.cmake NO_POLICY_SCOPE)
project(ubit_project)

message(WARNING "Main file: ${PROJECT_SOURCE_DIR}/src/main.c")

# Generate version file
include(build.version.cmake NO_POLICY_SCOPE)

FILE(GLOB app_sources src/*.c)

include_directories(
	"${PROJECT_BINARY_DIR}/include/generated"
    "${PROJECT_SOURCE_DIR}/include"
)

# Schedule a new version file generation after every build
add_custom_command(
    TARGET app
    POST_BUILD
    COMMAND "${CMAKE_COMMAND}"
    -DPROJECT_SOURCE_DIR=${PROJECT_SOURCE_DIR}
    -DPROJECT_BINARY_DIR=${PROJECT_BINARY_DIR}
    -P ${PROJECT_SOURCE_DIR}/build.version.cmake
)

list(APPEND SOURCES
    "${PROJECT_SOURCE_DIR}/src/main.c"
    "${PROJECT_SOURCE_DIR}/src/buttons.c"
	"${PROJECT_SOURCE_DIR}/src/i2c_util.c"
	"${PROJECT_SOURCE_DIR}/src/ubit_devices.c"
)

target_sources(app PRIVATE ${SOURCES})
```

## prj.conf
```kconfig
# nothing here

CONFIG_SENSOR=y
CONFIG_STDOUT_CONSOLE=y

CONFIG_GPIO=y
CONFIG_MICROBIT_DISPLAY=y
CONFIG_SYS_CLOCK_TICKS_PER_SEC=250

CONFIG_I2C=y
CONFIG_I2C_INIT_PRIORITY=60
CONFIG_I2C_0=y

CONFIG_I2C_GPIO=y
CONFIG_I2C_GPIO_0=y
CONFIG_I2C_GPIO_0_GPIO=y
CONFIG_I2C_GPIO_0_SCL_PIN=19
CONFIG_I2C_GPIO_0_SDA_PIN=20

CONFIG_SYS_LOG=y
CONFIG_SYS_LOG_DEFAULT_LEVEL=4
CONFIG_SYS_LOG_SHOW_COLOR=y

# Bluetooth settings configuration
#CONFIG_SYS_CLOCK_TICKS_PER_SEC=250
#CONFIG_ISR_STACK_SIZE=1024
#CONFIG_BT=y
#CONFIG_BT_CENTRAL=y
#CONFIG_BT_PERIPHERAL=y
#CONFIG_BT_GATT_CLIENT=y
#CONFIG_BT_DEVICE_NAME="ubitProject"
#CONFIG_GPIO=y
#CONFIG_MICROBIT_DISPLAY=y
#CONFIG_PWM=y
#CONFIG_PWM_NRF5_SW=y
```

## src/main.c
```c
#include "buttons.h"
#include "version.h"
#include "i2c_util.h"
#include "ubit_devices.h"

typedef enum {
	HELLO,
	TEMP,
	ACCEL,
	MAG,
	BLTH
} state_t;

typedef enum {
    NEXT,
    PREVIOUS,
    CURRENT
} event_t;

typedef struct {
    state_t events[3];
    void (*action)(void);
} mstate_t;

static event_t current_event = CURRENT;
static u8_t event_changed = 0;
static s64_t a_timestamp;
static s64_t b_timestamp;

//This function will be executed everytime a button is pressed
void button_pressed(struct device *dev, struct gpio_callback *cb, u32_t pins) {
	/* Filter out spurious presses */
	if (pins & BIT(SW0_GPIO_PIN)) {
		printk("\nChanging to previous state.\nPlease, wait a while...\n\n");
		current_event = PREVIOUS;
		if (k_uptime_delta(&a_timestamp) < K_MSEC(100)) {
			printk("Too quick A presses\n");
			return;
		}
	} else {
		current_event = NEXT;
		printk("\nChanging to next state.\nPlease, wait a while...\n\n");
		if (k_uptime_delta(&b_timestamp) < K_MSEC(100)) {
			printk("Too quick B presses\n");
			return;
		}
	}
	event_changed = 1;
}

mstate_t machine[] = {
	{ .events = {TEMP, BLTH, HELLO}, .action = print_to_display},    
	{ .events = {ACCEL, HELLO, TEMP}, .action = read_temperature},    
    { .events = {MAG, TEMP, ACCEL}, .action = update_accel_display},	
    { .events = {BLTH, ACCEL, MAG}, .action = print_compass_direction},	
    { .events = {HELLO, MAG, BLTH}, .action = connect_to_bluetooth}
};

void main(void) {
	printk("ECOM042.2017.2\n");
	printk("EMBBEDED SYSTEMS\n");
	printk("UBIT_PROJECT\n");
	SYS_LOG_WRN("Firmware version: v%d.%d.%d\n",
                        VERSION_MAJOR, VERSION_MINOR, VERSION_BUILD);

	//Initiate and configure devices
	init_display();	
	init_accelerometer_sensor();
	init_magnetometer_sensor();	
	configure_buttons();

	//Set the current machine state
	static state_t current_state = HELLO;

	while (1) {
		if(event_changed) {      
            current_state = machine[current_state].events[current_event];           
        }
		machine[current_state].action();
		current_event = CURRENT;
    	event_changed = 0;		
		k_sleep(get_sleep_time());	
	}
}
```

## include/bluetooth.h
```c
#include <zephyr.h>
#include <misc/printk.h>
#include <board.h>
#include <gpio.h>
#include <device.h>
#include <string.h>

#include <display/mb_display.h>

#include <bluetooth/bluetooth.h>
#include <bluetooth/uuid.h>
#include <bluetooth/conn.h>
#include <bluetooth/gatt.h>

void ble_init(void);
void ble_connect(void);
void conn_ready(bool initiator);
void ble_send_packet(s8_t data);
void packet_received(s8_t data);
void remote_disconnected(void);
void remote_lost(void);
void ble_send_lost(void);
void ble_cancel_connect(void);
```

## include/buttons.h
```c
#include <board.h>
#include <gpio.h>

void configure_buttons(void);

void button_pressed(struct device *dev, struct gpio_callback *cb, u32_t pins);
```

## include/i2c_util.h
```c
#ifndef __I2C_UTIL_H
#define __I2C_UTIL_H

#include <zephyr.h>
#include <misc/printk.h>
#include <board.h>
#include <gpio.h>
#include <device.h>
#include <i2c.h>
#include <string.h>

#define SYS_LOG_DOMAIN "PROJECT"
#include <logging/sys_log.h>

#define I2C_DEVICE_NAME_LENGTH 10

struct i2c_dev {
        struct device *dev;
        char name[I2C_DEVICE_NAME_LENGTH];
        u16_t addr;
        u8_t reg_test;
        u8_t reg_test_expected_val;
};

int i2c_util_dev_init(struct i2c_dev *i2c_dev, u16_t addr, const char *name, u8_t reg_test, u8_t reg_test_expected_val);
int i2c_util_write_bytes(struct i2c_dev *i2c_dev, u8_t reg, u8_t *data, u32_t num_bytes);
int i2c_util_read_bytes(struct i2c_dev *i2c_dev, u8_t reg, u8_t *data, u32_t num_bytes);
int i2c_util_test_connection(struct i2c_dev *i2c_dev);

#endif //__I2C_UTIL_H
```

## include/ubit_devices.h
```c
#ifndef __UBIT_DEVICES_H
#define __UBIT_DEVICES_H

/*! \file ubit_devices.h
    \brief Device functions definition.    
    This library will define functions to initiate sensors, 
    read data and print to microbit's display.
*/

#include <display/mb_display.h>
#include <sensor.h>

#define ACC_DEV_ADDR        0x1D
#define ACC_WHO_AM_I_REG    0x0D
#define ACC_TEST_VALUE      0x5A
#define ACC_CTRL_REG        0x2A
#define ACC_OUT_X_MSB       0x01
#define ACC_OUT_X_LSB       0x02
#define ACC_OUT_Y_MSB       0x03
#define ACC_OUT_Y_LSB       0x04
#define ACC_OUT_Z_MSB       0x05
#define ACC_OUT_Z_LSB       0x06

#define COMPASS_DEV_ADDR        0x0e
#define COMPASS_WHO_AM_I_REG    0x07
#define COMPASS_TEST_VALUE      0xC4
#define COMPASS_CTRL_REG        0x10
#define MAG_OUT_X_MSB           0x01
#define MAG_OUT_X_LSB           0x02
#define MAG_OUT_Y_MSB           0x03
#define MAG_OUT_Y_LSB           0x04
#define MAG_OUT_Z_MSB           0x05
#define MAG_OUT_Z_LSB           0x06


/*! \fn u16_t get_sleep_time()
    \brief Get the required sleep time to the current device.

    When temperature, accelerometer or magnetometer sensors are
    being used, their information require a certain time the be shown
    on microbit's display. This function return the required time.
*/
u16_t get_sleep_time();

/*! \fn void init_display()
    \brief Initiate the display device.

    This function must be called before printing anything to
    microbit's display.
*/
void init_display();

/*! \fn void init_temperature_sensor()
    \brief Initiate the display device.

    This function must be called in order to
    use the temperature sensor.
*/
void init_temperature_sensor();

/*! \fn void init_accelerometer_sensor()
    \brief Initiate the accelerometer device.

    This function must be called in order to
    use the accelerometer sensor.
*/
void init_accelerometer_sensor();

/*! \fn void init_magnetometer_sensor()
    \brief Initiate the magnetometer device.

    This function must be called in order to
    use the magnetometer sensor.
*/
void init_magnetometer_sensor();

/*! \fn void print_to_display(()
    \brief Print the message "ECOM042.2017.2" to microbit's display

*/
void print_to_display();

/*! \fn void read_temperature()
    \brief Read temperature value in degrees Celsius
*/
void read_temperature();

/*! \fn void read_accelerometer()
    \brief Read accelerometer x, y and z axis values
*/
void read_accelerometer();

/*! \fn void get_accelerometer_x()
    \brief Return accelerometer's x value

    Before use this function, read_accelerometer() must be called.
*/
u16_t get_accelerometer_x();

/*! \fn void get_accelerometer_y()
    \brief Return accelerometer's y value

    Before use this function, read_accelerometer() must be called.
*/
u16_t get_accelerometer_y();

/*! \fn void get_accelerometer_z()
    \brief Return accelerometer's z value

    Before use this function, read_accelerometer() must be called.
*/
u16_t get_accelerometer_z();

/*! \fn u8_t get_accel_col(u16_t x_accel)
    \brief Return the a display column
    \param x_accel The accelerometer x reading

    This function receives the current x acceleration data and returns a 
    valid column value to be set on the microbits display
*/
u8_t get_accel_col(u16_t x_accel);

/*! \fn u8_t get_accel_row(u16_t y_accel)
    \brief Return the a display column
    \param y_accel The accelerometer y reading

    This function receives the current y acceleration data and returns a 
    valid row value to be set on the microbits display
*/
u8_t get_accel_row(u16_t y_accel);

//Print a dot on microbit display
//according with the accelerometer readings

/*! \fn void update_accel_display()
    \brief Update a display pixel position    

    This function shows a moving dot on microbit's display. The dot
    moves according to the accelerometer sensor readings
*/
void update_accel_display();

/*! \fn void read_magnetometer()
    \brief Read magnetometer axis values
    
*/
void read_magnetometer();

/*! \fn u16_t read_compass_x()
    \brief Return magnetometer's x value

    Before use this function, read_magnetometer() must be called.
*/
u16_t read_compass_x();

/*! \fn u16_t read_compass_y()
    \brief Return magnetometer's y value

    Before use this function, read_magnetometer() must be called.
*/
u16_t read_compass_y();

/*! \fn u16_t read_compass_z()
    \brief Return magnetometer's z value

    Before use this function, read_magnetometer() must be called.
*/
u16_t read_compass_z();

/*! \fn print_compass_direction()
    \brief Print the direction which the board is pointing

    Print the direction which the board is pointing based on the
    magnetometer sensor readings. Possible directions are 'N', 'S',
    'L' and 'O'. If no direction is detected, a '?' will be displayed.
*/
void print_compass_direction();

/*! \fn connect_to_bluetooth()
    \brief Stablish a bluetooth connection with an external device

*/
void connect_to_bluetooth();

#endif //__UBIT_DEVICESL_H
```

## src/bluetooth.c
```c
#include "bluetooth.h"

/*
 * Copyright (c) 2017 Intel Corporation
 *
 * SPDX-License-Identifier: Apache-2.0
 */

#define SCAN_TIMEOUT     K_SECONDS(2)

#define APPEARANCE       0
#define DEVICE_NAME      CONFIG_BT_DEVICE_NAME
#define DEVICE_NAME_LEN  (sizeof(DEVICE_NAME) - 1)

#define SVC_UUID	0x90, 0x6c, 0x55, 0x0f, 0xee, 0x6f, 0x4d, 0x0d, \
			0xa1, 0x7e, 0x24, 0x4e, 0x38, 0xea, 0x4f, 0xf9
#define CHR_UUID	0xdd, 0x94, 0xaf, 0xd7, 0xcd, 0x2c, 0x40, 0xc6, \
			0xb5, 0x82, 0x6a, 0xc5, 0x1c, 0x8f, 0xbf, 0xab

static struct bt_uuid_128 svc_uuid = BT_UUID_INIT_128(SVC_UUID);
static struct bt_uuid_128 chr_uuid = BT_UUID_INIT_128(CHR_UUID);
static struct bt_uuid *gatt_ccc_uuid = BT_UUID_GATT_CCC;

static struct bt_gatt_discover_params discov_param;
static struct bt_gatt_subscribe_params subscribe_param;

static const struct bt_data ad[] = {
	BT_DATA_BYTES(BT_DATA_FLAGS, (BT_LE_AD_GENERAL | BT_LE_AD_NO_BREDR)),
	BT_DATA_BYTES(BT_DATA_UUID128_ALL, SVC_UUID),
};

static const struct bt_data sd[] = {
	BT_DATA(BT_DATA_NAME_COMPLETE, DEVICE_NAME, DEVICE_NAME_LEN),
};

static struct bt_conn *default_conn;

static const struct bt_gatt_attr *local_attr;
static u16_t remote_handle;
static bool remote_ready;
static bool initiator;

static struct k_delayed_work ble_work;

static bool connect_canceled;

static enum {
	BLE_DISCONNECTED,
	BLE_SCAN_START,
	BLE_SCAN,
	BLE_CONNECT_CREATE,
	BLE_CONNECT_CANCEL,
	BLE_ADV_START,
	BLE_ADVERTISING,
	BLE_CONNECTED,
} ble_state;

enum {
	BLE_PACKET_INFO = 0x00,
	BLE_LOST = 0x01,
};

struct ble_packet_info {
	s8_t packet_data;
	// s8_t y_pos;
	// s8_t x_vel;
	// s8_t y_vel;
} __packed;

struct ble_data {
	u8_t op;
	union {
		struct ble_packet_info packet;
	};
} __packed;

#define PACKET_INFO_LEN (1 + sizeof(struct ble_packet_info))

void ble_send_packet(s8_t data) {
	struct ble_data data = {
		.op           = BLE_PACKET_INFO,
		.packet.packet_data = data,		
	};
	int err;

	if (!default_conn || !remote_ready) {
		printk("ble_send_packet(): not ready\n");
		return;
	}

	printk("ble_send_packet(%d)\n", data);

	err = bt_gatt_notify(default_conn, local_attr, &data, PACKET_INFO_LEN);
	if (err) {
		printk("GATT notify failed (err %d)\n", err);
	}
}

void ble_send_lost(void) {
	u8_t lost = BLE_LOST;
	int err;

	if (!default_conn || !remote_ready) {
		printk("ble_send_lost(): not ready\n");
		return;
	}

	err = bt_gatt_notify(default_conn, local_attr, &lost, sizeof(lost));
	if (err) {
		printk("GATT notify failed (err %d)\n", err);
	}
}

static u8_t notify_func(struct bt_conn *conn, struct bt_gatt_subscribe_params *param, const void *buf, u16_t len) {
	const struct ble_data *data = buf;

	printk("notify_func() data %p len %u\n", data, len);

	if (!data || !len) {
		printk("Unsubscribed, disconnecting...\n");
		remote_handle = 0;
		if (default_conn) {
			bt_conn_disconnect(default_conn, BT_HCI_ERR_REMOTE_USER_TERM_CONN);
		}
		return BT_GATT_ITER_STOP;
	}

	switch (data->op) {
	case BLE_PACKET_INFO:
		if (len < PACKET_INFO_LEN) {
			printk("Too small packet info\n");
			break;
		}

		packet_received(data->packet.packet_data);
		break;
	case BLE_LOST:
		remote_lost();
		break;
	default:
		printk("Unknown op 0x%02x\n", data->op);
	}

	return BT_GATT_ITER_CONTINUE;
}

static u8_t discover_func(struct bt_conn *conn, const struct bt_gatt_attr *attr, struct bt_gatt_discover_params *param) {
	int err;

	if (!attr) {
		printk("Discover complete\n");
		memset(&discov_param, 0, sizeof(discov_param));
		return BT_GATT_ITER_STOP;
	}

	printk("Attribute handle %u\n", attr->handle);

	if (param->uuid == &svc_uuid.uuid) {
		printk("Service discovered\n");
		discov_param.uuid = &chr_uuid.uuid;
		discov_param.start_handle = attr->handle + 1;
		discov_param.type = BT_GATT_DISCOVER_CHARACTERISTIC;

		err = bt_gatt_discover(conn, &discov_param);
		if (err) {
			printk("Char Discovery failed (err %d)\n", err);
		}
	} else if (param->uuid == &chr_uuid.uuid) {
		printk("Characteristic discovered\n");
		discov_param.uuid = gatt_ccc_uuid;
		discov_param.start_handle = attr->handle + 2;
		discov_param.type = BT_GATT_DISCOVER_DESCRIPTOR;
		subscribe_param.value_handle = attr->handle + 1;

		err = bt_gatt_discover(conn, &discov_param);
		if (err) {
			printk("CCC Discovery failed (err %d)\n", err);
		}
	} else {
		printk("CCC discovered\n");

		subscribe_param.notify = notify_func;
		subscribe_param.value = BT_GATT_CCC_NOTIFY;
		subscribe_param.ccc_handle = attr->handle;

		printk("CCC handle 0x%04x Value handle 0x%04x\n",
		       subscribe_param.ccc_handle,
		       subscribe_param.value_handle);

		err = bt_gatt_subscribe(conn, &subscribe_param);
		if (err && err != -EALREADY) {
			printk("Subscribe failed (err %d)\n", err);
		} else {
			printk("Subscribed\n");
		}

		remote_handle = attr->handle;
	}

	if (remote_handle && remote_ready) {
		conn_ready(initiator);
	}

	return BT_GATT_ITER_STOP;
}

static void connected(struct bt_conn *conn, u8_t err) {
	struct bt_conn_info info;

	if (err) {
		printk("Connection failed (err %u)\n", err);
		return;
	}

	if (ble_state == BLE_ADVERTISING) {
		bt_le_adv_stop();
	}

	if (!default_conn) {
		default_conn = bt_conn_ref(conn);
	}

	bt_conn_get_info(conn, &info);
	initiator = (info.role == BT_CONN_ROLE_MASTER);
	remote_ready = false;
	remote_handle = 0;

	printk("Connected\n");
	ble_state = BLE_CONNECTED;

	k_delayed_work_submit(&ble_work, K_NO_WAIT);
}

static void disconnected(struct bt_conn *conn, u8_t reason) {
	printk("Disconnected (reason %u)\n", reason);

	if (default_conn) {
		bt_conn_unref(default_conn);
		default_conn = NULL;
	}

	remote_handle = 0;

	if (ble_state == BLE_CONNECTED) {
		ble_state = BLE_DISCONNECTED;
		remote_disconnected();
	}
}

static struct bt_conn_cb conn_callbacks = {
	.connected = connected,
	.disconnected = disconnected,
};

void ble_connect(void) {
	if (ble_state != BLE_DISCONNECTED) {
		printk("Not ready to connect\n");
		return;
	}

	ble_state = BLE_SCAN_START;
	k_delayed_work_submit(&ble_work, K_NO_WAIT);
}

void ble_cancel_connect(void) {
	printk("ble_cancel_connect()\n");

	k_delayed_work_cancel(&ble_work);

	switch (ble_state) {
	case BLE_DISCONNECTED:
		break;
	case BLE_SCAN_START:
		ble_state = BLE_DISCONNECTED;
		break;
	case BLE_SCAN:
		connect_canceled = true;
		k_delayed_work_submit(&ble_work, K_NO_WAIT);
		break;
	case BLE_ADV_START:
		ble_state = BLE_DISCONNECTED;
		break;
	case BLE_ADVERTISING:
		connect_canceled = true;
		k_delayed_work_submit(&ble_work, K_NO_WAIT);
		break;
	case BLE_CONNECT_CREATE:
		ble_state = BLE_CONNECT_CANCEL;
		/* Intentional fall-through */
	case BLE_CONNECTED:
		connect_canceled = true;
		k_delayed_work_submit(&ble_work, K_NO_WAIT);
		break;
	case BLE_CONNECT_CANCEL:
		break;
	}
}

static bool uuid_match(const u8_t *data, u8_t len) {
	while (len >= 16) {
		if (!memcmp(data, svc_uuid.val, 16)) {
			return true;
		}

		len -= 16;
		data += 16;
	}

	return false;
}

static void create_conn(const bt_addr_le_t *addr) {
	if (default_conn) {
		return;
	}

	printk("Found matching device, initiating connection...\n");

	default_conn = bt_conn_create_le(addr, BT_LE_CONN_PARAM_DEFAULT);
	if (!default_conn) {
		printk("Failed to initiate connection");
		return;
	}

	ble_state = BLE_CONNECT_CREATE;
	k_delayed_work_submit(&ble_work, SCAN_TIMEOUT);
}

static void device_found(const bt_addr_le_t *addr, s8_t rssi, u8_t type, struct net_buf_simple *ad) {
	if (type != BT_LE_ADV_IND) {
		return;
	}

	while (ad->len > 1) {
		u8_t len = net_buf_simple_pull_u8(ad);
		u8_t type;

		/* Check for early termination */
		if (len == 0) {
			return;
		}

		if (len > ad->len) {
			printk("AD malformed\n");
			return;
		}

		type = net_buf_simple_pull_u8(ad);
		if (type == BT_DATA_UUID128_ALL &&
		    uuid_match(ad->data, len - 1)) {
			bt_le_scan_stop();
			create_conn(addr);
			return;
		}

		net_buf_simple_pull(ad, len - 1);
	}
}

static u32_t adv_timeout(void) {
	u32_t timeout;

	if (bt_rand(&timeout, sizeof(timeout)) < 0) {
		return K_SECONDS(10);
	}

	timeout %= K_SECONDS(10);

	return timeout + K_SECONDS(1);
}

static void cancel_connect(void) {
	connect_canceled = false;

	switch (ble_state) {
	case BLE_SCAN:
		bt_le_scan_stop();
		break;
	case BLE_ADVERTISING:
		bt_le_adv_stop();
		break;
	case BLE_CONNECT_CREATE:
	case BLE_CONNECTED:
		bt_conn_disconnect(default_conn,
				   BT_HCI_ERR_REMOTE_USER_TERM_CONN);
		break;
	default:
		break;
	}

	/* For CONNECTED the state will be updated in the disconnected cb */
	if (ble_state != BLE_CONNECTED) {
		ble_state = BLE_DISCONNECTED;
	}
}

static void ble_timeout(struct k_work *work) {
	int err;

	if (connect_canceled) {
		cancel_connect();
		return;
	}

	switch (ble_state) {
	case BLE_DISCONNECTED:
		break;
	case BLE_SCAN_START:
		err = bt_le_scan_start(BT_LE_SCAN_PASSIVE, device_found);
		if (err) {
			printk("Scanning failed to start (err %d)\n", err);
		}

		printk("Started scanning for devices\n");
		ble_state = BLE_SCAN;
		k_delayed_work_submit(&ble_work, SCAN_TIMEOUT);
		break;
	case BLE_CONNECT_CREATE:
		printk("Connection attempt timed out\n");
		bt_conn_disconnect(default_conn,
				   BT_HCI_ERR_REMOTE_USER_TERM_CONN);
		ble_state = BLE_ADV_START;
		k_delayed_work_submit(&ble_work, K_NO_WAIT);
		break;
	case BLE_SCAN:
		printk("No devices found during scan\n");
		bt_le_scan_stop();
		ble_state = BLE_ADV_START;
		k_delayed_work_submit(&ble_work, K_NO_WAIT);
		break;
	case BLE_ADV_START:
		err = bt_le_adv_start(BT_LE_ADV_CONN, ad, ARRAY_SIZE(ad),
				      sd, ARRAY_SIZE(sd));
		if (err) {
			printk("Advertising failed to start (err %d)\n", err);
			return;
		}

		printk("Advertising successfully started\n");
		ble_state = BLE_ADVERTISING;
		k_delayed_work_submit(&ble_work, adv_timeout());
		break;
	case BLE_ADVERTISING:
		printk("Timed out advertising\n");
		bt_le_adv_stop();
		ble_state = BLE_SCAN_START;
		k_delayed_work_submit(&ble_work, K_NO_WAIT);
		break;
	case BLE_CONNECTED:
		discov_param.uuid = &svc_uuid.uuid;
		discov_param.func = discover_func;
		discov_param.start_handle = 0x0001;
		discov_param.end_handle = 0xffff;
		discov_param.type = BT_GATT_DISCOVER_PRIMARY;

		err = bt_gatt_discover(default_conn, &discov_param);
		if (err) {
			printk("Discover failed (err %d)\n", err);
			return;
		}
		break;
	case BLE_CONNECT_CANCEL:
		break;
	}
}

static struct bt_gatt_ccc_cfg ccc_cfg[BT_GATT_CCC_MAX];

static void ccc_cfg_changed(const struct bt_gatt_attr *attr, u16_t val) {
	printk("val %u\n", val);

	remote_ready = (val == BT_GATT_CCC_NOTIFY);

	if (remote_ready && remote_handle) {
		conn_ready(initiator);
	}
}

static struct bt_gatt_attr attrs[] = {
	/* Vendor Primary Service Declaration */
	BT_GATT_PRIMARY_SERVICE(&svc_uuid.uuid),
	BT_GATT_CHARACTERISTIC(&chr_uuid.uuid, BT_GATT_CHRC_NOTIFY,
			       BT_GATT_PERM_NONE, NULL, NULL, NULL),
	BT_GATT_CCC(ccc_cfg, ccc_cfg_changed),
};

static struct bt_gatt_service svc = BT_GATT_SERVICE(attrs);

void ble_init(void) {
	int err;

	err = bt_enable(NULL);
	if (err) {
		printk("Enabling Bluetooth failed (err %d)\n", err);
		return;
	}

	k_delayed_work_init(&ble_work, ble_timeout);

	bt_conn_cb_register(&conn_callbacks);


	local_attr = &attrs[2];
	bt_gatt_service_register(&svc);
}
```

## src/buttons.c
```c
#include "buttons.h"

void configure_buttons(void) {
	static struct gpio_callback button_cb;
	struct device *gpio;

	gpio = device_get_binding(SW0_GPIO_NAME);

	gpio_pin_configure(gpio, SW0_GPIO_PIN,
			   (GPIO_DIR_IN | GPIO_INT | GPIO_INT_EDGE |
			    GPIO_INT_ACTIVE_LOW));
	gpio_pin_configure(gpio, SW1_GPIO_PIN,
			   (GPIO_DIR_IN | GPIO_INT | GPIO_INT_EDGE |
			    GPIO_INT_ACTIVE_LOW));
	gpio_init_callback(&button_cb, button_pressed,
			   BIT(SW0_GPIO_PIN) | BIT(SW1_GPIO_PIN));
	gpio_add_callback(gpio, &button_cb);

	gpio_pin_enable_callback(gpio, SW0_GPIO_PIN);
	gpio_pin_enable_callback(gpio, SW1_GPIO_PIN);
}
```

## src/i2c_util.c
```c
#include "i2c_util.h"

int i2c_util_dev_init(struct i2c_dev *i2c_dev, u16_t addr, const char *name,
                        u8_t reg_test, u8_t reg_test_expected_val)
{
        i2c_dev->addr = addr;
        strcpy(i2c_dev->name, name);
        i2c_dev->reg_test = reg_test;
        i2c_dev->reg_test_expected_val = reg_test_expected_val;

        int ret;
        i2c_dev->dev = device_get_binding(CONFIG_I2C_GPIO_0_NAME);
        if (!i2c_dev->dev) {
            printk("I2C: Device driver not found.\n");
            return 1;
        }

        ret = i2c_configure(i2c_dev->dev, I2C_SPEED_SET(I2C_SPEED_STANDARD) |
                                I2C_MODE_MASTER);
        if(ret) {
            SYS_LOG_ERR("Could not configure I2C device. Erro code: %d", ret);
            goto ret_err;
        }
        SYS_LOG_INF("device %s Configured successfuly.", i2c_dev->name);

        u8_t id = 0;
        ret = i2c_util_read_bytes(i2c_dev, i2c_dev->reg_test, &id, 1);
        if (ret) {
            SYS_LOG_WRN("Could not comunicate with %s. Error Code %d",
                        i2c_dev->name, ret);
            goto ret_err;
        }

        if (id == i2c_dev->reg_test_expected_val) {
                SYS_LOG_DBG("I2C test Success. Read value: 0x%X!", id);
        }
        else {
                SYS_LOG_WRN("I2C test Fail. Read value: 0x%X | Expected \
                                value: 0x%X", id,
                                i2c_dev->reg_test_expected_val);
                goto ret_err;
        }

ret_err:
        return ret;
}

int i2c_util_write_bytes(struct i2c_dev *i2c_dev, u8_t reg, u8_t *data, u32_t num_bytes)
{
        struct i2c_msg msgs[2];

        /* Send the address to read from */

        msgs[0].buf = &reg;
        msgs[0].len = 1;
        msgs[0].flags = I2C_MSG_WRITE;

        /* Read from device. STOP after this. */
        msgs[1].buf = data;
        msgs[1].len = num_bytes;
        msgs[1].flags = I2C_MSG_WRITE | I2C_MSG_STOP;

        return i2c_transfer(i2c_dev->dev, &msgs[0], 2, i2c_dev->addr);//2
}

int i2c_util_read_bytes(struct i2c_dev *i2c_dev, u8_t reg, u8_t *data, u32_t num_bytes)
{
        struct i2c_msg msgs[2];

        /* Send the address to read from */

        msgs[0].buf = &reg;
        msgs[0].len = 1;
        msgs[0].flags = I2C_MSG_WRITE;

        /* Read from device. STOP after this. */
        msgs[1].buf = data;
        msgs[1].len = num_bytes;
        msgs[1].flags = I2C_MSG_READ | I2C_MSG_STOP;

        return i2c_transfer(i2c_dev->dev, msgs, 2, i2c_dev->addr);
}

int i2c_util_test_connection(struct i2c_dev *i2c_dev)
{
        int ret;
        u8_t id = 0;
        ret = i2c_util_read_bytes(i2c_dev, i2c_dev->reg_test, &id, 1);
        if (ret) {
            SYS_LOG_WRN("Could not comunicate with %s. Error Code %d",
                        i2c_dev->name, ret);
            goto ret_err;
        }

        if (id == i2c_dev->reg_test_expected_val) {
                SYS_LOG_DBG("I2C test Success. Read value: 0x%X!", id);
        }
        else {
                SYS_LOG_WRN("I2C test Fail. Read value: 0x%X | Expected \
                                value: 0x%X", id,
                                i2c_dev->reg_test_expected_val);
                goto ret_err;
        }

ret_err:
        return ret;
}
```

## src/ubit_devices.c
```c
#include "ubit_devices.h"
#include "i2c_util.h"

static struct mb_display *__disp;
static struct sensor_value __temp_value;
static struct device *__temperature_device;
static struct i2c_dev __acc;
static struct i2c_dev __compass;

static u8_t __init_display = 0;
static u8_t __init_temperature = 0;
static u8_t __init_accelerometer = 0;
static u8_t __init_magnetometer = 0;

static u16_t __accelerometer_x = 0;
static u16_t __accelerometer_y = 0;
static u16_t __accelerometer_z = 0;

static u16_t __magnetometer_x = 0;
static u16_t __magnetometer_y = 0;
static u16_t __magnetometer_z = 0;

static u16_t __sleep_time = 0;

static u8_t __row = 2;  //image center row
static u8_t __col = 2;  //center column
static struct mb_image __image = MB_IMAGE(
    { 0, 0, 0, 0, 0 },
    { 0, 0, 0, 0, 0 },
    { 0, 0, 0, 0, 0 },
    { 0, 0, 0, 0, 0 },
    { 0, 0, 0, 0, 0 }
);

u16_t get_sleep_time() {
    return __sleep_time;
}

void init_display() {
    if(!__init_display) {
        __disp = mb_display_get();
        __init_display = 1;
        return;
    }
    printk("Display already initiated.\n");
}

void init_temperature_sensor() {
    if(!__init_temperature) {
        __temperature_device = device_get_binding("TEMP_0");
        __init_temperature = 1;
    }
}

void init_accelerometer_sensor() {    
    u8_t temp = 0x01;
	i2c_util_dev_init(&__acc, ACC_DEV_ADDR, "ACC", ACC_WHO_AM_I_REG,
                                ACC_TEST_VALUE);
    i2c_util_test_connection(&__acc);
    i2c_util_write_bytes(&__acc, ACC_CTRL_REG, &temp, sizeof(u8_t));
    __init_accelerometer = 1;
}

void init_magnetometer_sensor() {    
    u8_t temp = 0x01;
	i2c_util_dev_init(&__compass, COMPASS_DEV_ADDR, "COMPASS", COMPASS_WHO_AM_I_REG,
                                 COMPASS_TEST_VALUE);
    i2c_util_test_connection(&__compass);
    i2c_util_write_bytes(&__compass, COMPASS_CTRL_REG, &temp, sizeof(u8_t));
    __init_magnetometer = 1;
}

void print_to_display() {
    if(!__init_display) {
        init_display();
    }
	mb_display_print(__disp, MB_DISPLAY_MODE_DEFAULT | MB_DISPLAY_FLAG_LOOP, 
    K_MSEC(500), "ECOM042.2017.2");
    printk("ECOM042.2017.2\n");
    __sleep_time = 8000;
}

void read_temperature() {
    if(!__init_temperature) {
        init_temperature_sensor();
    }
    	
    int r;    
	r = sensor_sample_fetch(__temperature_device);
	if (r) {
		printf("sensor_sample_fetch failed return: %d\n", r);
		return;
	}

	r = sensor_channel_get(__temperature_device, SENSOR_CHAN_TEMP, &__temp_value);
	if (r) {
		printf("sensor_channel_get failed return: %d\n", r);
		return;
	}    
    int val = (int)sensor_value_to_double(&__temp_value);
    mb_display_print(__disp, MB_DISPLAY_MODE_DEFAULT | MB_DISPLAY_FLAG_LOOP, 
    K_MSEC(500), "%dC\n", val);
    printf("Temperature is %d ºC\n", val);
    __sleep_time = 2500;    
}

void read_accelerometer() {
    if(!__init_accelerometer) {
        init_accelerometer_sensor();        
    }
    u8_t data[6];
    
    i2c_util_read_bytes(&__acc, ACC_OUT_X_MSB, data, sizeof(data));
    __accelerometer_x = data[0];
    __accelerometer_y = data[2];
    __accelerometer_z = data[4];

    SYS_LOG_DBG("ACC X: %d", data[0]);
    SYS_LOG_DBG("ACC Y: %d", data[2]);
    SYS_LOG_DBG("ACC Z: %d\n", data[4]);

    __sleep_time = 1000;
}

u16_t get_accelerometer_x() {    
    return __accelerometer_x;
}

u16_t get_accelerometer_y() {
    return __accelerometer_y;
}

u16_t get_accelerometer_z() {    
    return __accelerometer_z;
}

void read_magnetometer() {
    if(!__init_magnetometer) {
        init_magnetometer_sensor();        
    }
    u8_t data[2];
    
    i2c_util_read_bytes(&__compass, MAG_OUT_X_MSB, data, sizeof(data));
    __magnetometer_x = ((data[1] << 8) | data[0]);    
    SYS_LOG_DBG("MAG X: %d", __magnetometer_x);

    i2c_util_read_bytes(&__compass, MAG_OUT_Y_MSB, data, sizeof(data));
    __magnetometer_y = ((data[1] << 8) | data[0]);
    SYS_LOG_DBG("MAG Y: %d", __magnetometer_y);

    i2c_util_read_bytes(&__compass, MAG_OUT_Z_MSB, data, sizeof(data));
    __magnetometer_z = ((data[1] << 8) | data[0]);
    SYS_LOG_DBG("MAG Z: %d\n", __magnetometer_z);

    __sleep_time = 100;
}

u16_t get_magnetometer_x() {    
    return __magnetometer_x;
}

u16_t get_magnetometer_y() {    
    return __magnetometer_y;
}

u16_t get_magnetometer_z() {
    return __magnetometer_z;
}

void print_compass_direction() {
    read_magnetometer();
    if( get_magnetometer_x() >= 57000 && get_magnetometer_x() <= 61000 &&
        get_magnetometer_y() >= 30000 && get_magnetometer_y() <= 34000 &&
        get_magnetometer_z() >= 60000 && get_magnetometer_x() <= 65000) {
        
        mb_display_print(__disp, MB_DISPLAY_MODE_SINGLE, K_MSEC(500), "N");        
    }
    else if( get_magnetometer_x() >= 4000 && get_magnetometer_x() <= 7000 &&
        get_magnetometer_y() >= 50000 && get_magnetometer_y() <= 54000 &&
        get_magnetometer_z() >= 14000 && get_magnetometer_x() <= 18000) {

        mb_display_print(__disp, MB_DISPLAY_MODE_SINGLE, K_MSEC(500), "S");        
    }
    else if( get_magnetometer_x() >= 46000 && get_magnetometer_x() <= 50000 &&
        get_magnetometer_y() >= 55000 && get_magnetometer_y() <= 60000 &&
        get_magnetometer_z() >= 58000 && get_magnetometer_x() <= 64000) {

        mb_display_print(__disp, MB_DISPLAY_MODE_SINGLE, K_MSEC(500), "O");        
    }
    else if( get_magnetometer_x() >= 4000 && get_magnetometer_x() <= 7000 &&
        get_magnetometer_y() >= 50000 && get_magnetometer_y() <= 54000 &&
        get_magnetometer_z() >= 14000 && get_magnetometer_x() <= 18000) {

        mb_display_print(__disp, MB_DISPLAY_MODE_SINGLE, K_MSEC(500), "L");        
    }

    mb_display_print(__disp, MB_DISPLAY_MODE_SINGLE, K_MSEC(500), "?");
}

void connect_to_bluetooth() {
    printk("No bluetooth interface implemented.\n");    
    printk("Connection could not be stablished...\n");
    __sleep_time = 1000;
}

void update_accel_display() {
    // u16_t x, y;
    read_accelerometer();
    //Clear display pixel
    __image.row[__row] = __image.row[__row] & ~BIT(__col);    

    //Get the new position of the pixel according
    //with the accelerometer
    __col = get_accel_col(get_accelerometer_x());
    __row = get_accel_row(get_accelerometer_y());

    //Set the display pixel
    __image.row[__row] = __image.row[__row] | BIT(__col);
    mb_display_image(__disp, MB_DISPLAY_MODE_SINGLE, K_MSEC(1000), &__image, 1);    
}

u8_t get_accel_col(u16_t x_accel) {
    u8_t ret = 2; //center as default
    if( x_accel >= 190 && x_accel < 200 ) {
        ret = 4;
    }
    else if(x_accel >= 200 && x_accel < 220) {
        ret = 3;
    }
    else if(x_accel >= 220 && x_accel <= 255) {
        ret = 2;
    } else if(x_accel >= 0 && x_accel < 20) {
        ret = 1;
    } else if(x_accel >= 20 && x_accel < 70) {
        ret = 0;
    }
    return ret;
}

u8_t get_accel_row(u16_t y_accel) {
    u8_t ret = 2; //center as default
    if( y_accel >= 190 && y_accel < 200 ) {
        ret = 4;
    }
    else if(y_accel >= 200 && y_accel < 220) {
        ret = 3;
    }
    else if(y_accel >= 220 && y_accel <= 255) {
        ret = 2;
    } else if(y_accel >= 0 && y_accel < 20) {
        ret = 1;
    } else if(y_accel >= 20 && y_accel < 70) {
        ret = 0;
    }
    return ret;
}
```
